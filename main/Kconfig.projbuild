## main/Kconfig.projbuild
```kconfig
menu "User Configuration"

    config BLINK_GPIO
        int "Blink GPIO number"
        range 0 34
        default 5
        help
            GPIO number (IOxx) to blink on and off.

            Some GPIOs are used for other purposes (flash connections, etc.) and cannot be used to blink.

            GPIOs 35-39 are input-only so cannot be used as outputs.

    config WARN_SECONDS
            int "every X seconds warning"
            default 10
            help
                Every X seconds the ESP will log a warning in the terminal.

endmenu
```
